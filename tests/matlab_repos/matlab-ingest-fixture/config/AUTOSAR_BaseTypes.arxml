AUTOSAR XML (schema 4-0-3)
standard types defined: boolean, uint8, uint16, uint32, sint8, sint16, sint32, float32, float64, void
package /AUTOSAR_PlatformTypes/BaseTypes  # Blueprints for AUTOSAR Base Types for AUTOSAR Platform types for TC1796
